## boards/espressif/esp32_azdelivery/Kconfig.esp32_azdelivery
```kconfig
config BOARD_ESP32_AZDELIVERY
  select SOC_ESP32_WROOM_32UE_N4
  select SOC_ESP32_PROCPU if BOARD_ESP32_AZDELIVERY_ESP32_PROCPU
  select SOC_ESP32_APPCPU if BOARD_ESP32_AZDELIVERY_ESP32_APPCPU
```

## boards/espressif/esp32_azdelivery/board.yml
```yaml
board:
  name: esp32_azdelivery
  full_name: ESP32 AZDelivery
  vendor: espressif
  socs:
    - name: esp32
```

## boards/espressif/esp32_azdelivery/esp32_azdelivery_procpu.defconfig
```kconfig
CONFIG_SOC_SERIES_ESP32=y
CONFIG_SOC_ESP32=y
CONFIG_SOC_ESP32_WROOM32=y
CONFIG_BOARD_ESP32_AZDELIVERY_PROCPU=y
```

## build/Kconfig/arch/Kconfig
```kconfig
# Load Zephyr Arch Kconfig descriptions.
osource "/home/gucio/zephyrproject/zephyr/arch/rx/Kconfig"
osource "/home/gucio/zephyrproject/zephyr/arch/x86/Kconfig"
osource "/home/gucio/zephyrproject/zephyr/arch/xtensa/Kconfig"
osource "/home/gucio/zephyrproject/zephyr/arch/sparc/Kconfig"
osource "/home/gucio/zephyrproject/zephyr/arch/riscv/Kconfig"
osource "/home/gucio/zephyrproject/zephyr/arch/posix/Kconfig"
osource "/home/gucio/zephyrproject/zephyr/arch/openrisc/Kconfig"
osource "/home/gucio/zephyrproject/zephyr/arch/mips/Kconfig"
osource "/home/gucio/zephyrproject/zephyr/arch/arm64/Kconfig"
osource "/home/gucio/zephyrproject/zephyr/arch/arm/Kconfig"
osource "/home/gucio/zephyrproject/zephyr/arch/arc/Kconfig"
```

## build/Kconfig/boards/Kconfig.stm32f746g_disco
```kconfig
# Load board Kconfig descriptions.
osource "/home/gucio/zephyrproject/zephyr/boards/st/stm32f746g_disco/Kconfig.stm32f746g_disco"
```
